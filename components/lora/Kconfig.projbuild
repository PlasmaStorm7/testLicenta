## components/lora/Kconfig.projbuild
```kconfig
menu "LoRa Configuration"

    config LORA_CS_GPIO
        int "CS GPIO"
        range 0 35
        default 12
        help
            Pin Number where the NCS pin of the LoRa module is connected to.

    config LORA_RST_GPIO
        int "RST GPIO"
        range 0 35
        default 9
        help
            Pin Number where the NRST pin of the LoRa module is connected to.

    config LORA_MISO_GPIO
        int "MISO GPIO"
        range 0 35
        default 21
        help
            Pin Number to be used as the MISO SPI signal.

    config LORA_MOSI_GPIO
        int "MOSI GPIO"
        range 0 35
        default 19
        help
            Pin Number to be used as the MOSI SPI signal.

    config LORA_SCK_GPIO
        int "SCK GPIO"
        range 0 35
        default 20
        help
            Pin Number to be used as the SCK SPI signal.

    config LORA_DIO0_GPIO
        int "DIO0_GPIO"
        range 0 35
        default 4
        help
            Pin Number to be connected to DIO0 of the LoRa module

    config LORA_DIO1_GPIO
        int "DIO1_GPIO"
        range 0 35
        default 5
        help
            Pin Number to be connected to DIO1 of the LoRa module

    config LORA_DIO2_GPIO
        int "DIO2_GPIO"
        range 0 35
        default 6
        help
            Pin Number to be connected to DIO2 of the LoRa module

    config LORA_DIO3_GPIO
        int "DIO3_GPIO"
        range 0 35
        default 7
        help
            Pin Number to be connected to DIO3 of the LoRa module

    config LORA_DIO4_GPIO
        int "DIO4_GPIO"
        range 0 35
        default 22
        help
            Pin Number to be connected to DIO4 of the LoRa module
    config LORA_DIO5_GPIO
        int "DIO5_GPIO"
        range 0 35
        default 8
        help
            Pin Number to be connected to DIO4 of the LoRa module

endmenu
```

## main/Kconfig.projbuild
```kconfig
menu "Example Configuration"

    config EXAMPLE_STORE_HISTORY
        bool "Store command history in flash"
        default y
        help
            Linenoise line editing library provides functions to save and load
            command history. If this option is enabled, initalizes a FAT filesystem
            and uses it to store command history.

    config EXAMPLE_MAX_COMMAND_LINE_LENGTH
        int "Maximum command line length"
        default 1024
        help
            This value marks the maximum length of a single command line. Once it is
            reached, no more characters will be accepted by the console.

            # choice EXAMPLE_NMEA_INTERFACE
            #     prompt "Interface to connect the GPS over"
            #     default EXAMPLE_NMEA_INTERFACE_UART

            #     config EXAMPLE_NMEA_INTERFACE_UART
            #         bool "UART"

            #     config EXAMPLE_NMEA_INTERFACE_I2C
            #         bool "I2C"

            # endchoice

            # if EXAMPLE_NMEA_INTERFACE_UART
            #     config EXAMPLE_UART_NUM
            #         int "UART port number"
            #         default 1

            #     config EXAMPLE_UART_RX
            #         int "UART RX GPIO number"
            #         default 21
            # endif

            # if EXAMPLE_NMEA_INTERFACE_I2C
            #     config EXAMPLE_I2C_NUM
            #         int "I2C port number"
            #         default 0
            #     config EXAMPLE_I2C_SDA_PIN
            #         int "I2C SDA GPIO number"
            #         default 24
            #     config EXAMPLE_I2C_SCL_PIN
            #         int "I2C SCL GPIO number"
            #         default 25
            #     config EXAMPLE_I2C_SLAVE_ADDR
            #         hex "I2C address of the GPS"
            #         default 0x10
            # endif
endmenu
```
